## config/west.yml
```yaml
manifest:
  remotes:
    - name: zmkfirmware
      url-base: https://github.com/zmkfirmware
    - name: kumamuk-git
      url-base: https://github.com/kumamuk-git
    - name: kloir-z
      url-base: https://github.com/kloir-z
    - name: caksoylar  # <-- new entry
      url-base: https://github.com/caksoylar
    - name: kot149
      url-base: https://github.com/kot149
  projects:
    - name: zmk
      remote: zmkfirmware
      revision: main
      import: app/west.yml
    - name: zmk-pmw3610-driver
      remote: kloir-z
      revision: scroll-acceleration-feature
    - name: zmk-rgbled-widget  # <-- new entry
      remote: caksoylar
      revision: main
    - name: zmk-layout-shift
      remote: kot149
      revision: v1
  self:
    path: config
```
